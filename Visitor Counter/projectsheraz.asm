LIST P=PIC18F452, F=INHX32, N=0, ST=OFF, R=HEX
config OSC=HS, OSCS=OFF, WDT=OFF, BORV=45, PWRT=ON, BOR=ON, DEBUG=OFF, LVP=OFF, STVR=OFF

#INCLUDE <P18F452.INC>
ORG 00H 
GOTO MAIN

ORG 08H

BTFSS INTCON,TMR0IF ; Timer0 interrupt ?
RETFIE
GOTO ISR



MAIN
ORG 200H

LCD_DATA EQU PORTD
LCD_CTRL EQU PORTC
RS EQU RC0
RW EQU RC1
EN EQU RC2



BCF TRISC,0
BCF TRISC,1
BCF TRISC,2 

CLRF TRISD

MOVLW 01H
MOVWF 30H

BCF LCD_CTRL,EN
CALL DELAY
MOVLW 0X38;8BIT 2LINES
CALL COMWRT
CALL DELAY
MOVLW 0X0E;CURSON ON
CALL COMWRT
CALL DELAY
MOVLW 0X01
CALL COMWRT
CALL DELAY
MOVLW 0X06
CALL COMWRT
CALL DELAY

MOVLW 80H
CALL COMWRT
CALL DELAY

;TO GOTO 2ND LINE

;MOVLW 0C0H
;CALL COMWRT
;CALL SSDELAY
;
;TO CLEAR LCD
;MOVLW 0X01
;CALL COMWRT
;CALL SSDELAY

;LCD VARIABLES SETTING END

;


;***************************************************************************
;*************************************CODE STARTS HERE**********************
;***************************************************************************
;

BCF INTCON,TMR0IF

BSF INTCON,TMR0IE
BSF INTCON,GIE

CALL INITIALDISPLAY

AGAIN

;
;CALL SSDELAY
;MOVF 03H,W
;CALL H2A
;CALL SSDELAY

MOVLW 0x68
MOVWF T0CON

MOVLW 0xFF
MOVWF TMR0L

BTFSS PORTA,4
BRA AGAIN
;TO CLEAR LCD

AGAIN2
BTFSC PORTB,0
BRA INC

BTFSC PORTB,4
BRA DEC

BRA AGAIN2




INC
MOVLW 0X01
CALL COMWRT
CALL SSDELAY

BSF T0CON,7
MOVF 00H,W;INC COUNTER
ADDWF 01H
CLRF 00H
BRA CALCULATE

BRA AGAIN

DEC
MOVLW 0X01
CALL COMWRT
CALL DELAY

BSF T0CON,7
MOVF 00H,W;INC COUNTER
ADDWF 02H
CLRF 00H
BRA CALCULATE

BRA AGAIN

CALCULATE
MOVF 02H,W

SUBWF 01H,W
MOVWF 03H

BRA PRINT


PRINT


MOVLW A' '
CALL DATAWRT
CALL SSDELAY
MOVLW A' '
CALL DATAWRT
CALL SSDELAY
MOVLW A' '
CALL DATAWRT
CALL SSDELAY
MOVLW A' '
CALL DATAWRT
CALL SSDELAY
MOVLW A' '
CALL DATAWRT
CALL SSDELAY
MOVLW A' '
CALL DATAWRT
CALL SSDELAY
MOVLW A' '
CALL DATAWRT
CALL SSDELAY


CALL SSDELAY
MOVF 03H,W
CALL H2A
CALL SSDELAY

MOVFF PORTA,77H
MOVF 77H,W
STUCK CPFSEQ PORTA
BRA AGAIN
BRA STUCK











;FOR LCD DISPLAYING;

COMWRT
MOVWF LCD_DATA
BCF LCD_CTRL,RS ;AS COMMAND MODE SELECT REGISTER = 0
BCF LCD_CTRL,RW ; AS OUTPUT WRITE MODE IN LCD
BSF LCD_CTRL,EN ;ENABLER PIN
CALL SSDELAY
BCF LCD_CTRL,EN

RETURN

DATAWRT
MOVWF LCD_DATA
BSF LCD_CTRL,RS ;AS DATA MODE SELECT REGISTER =1
BCF LCD_CTRL,RW ; AS OUTPUT WRITE MODE IN LCD
BSF LCD_CTRL,EN ;ENABLER PIN
CALL SSDELAY
BCF LCD_CTRL,EN

RETURN

DELAY
MOVLW 00H
MOVWF T1CON
MOVLW 3CH
MOVWF TMR1H
MOVLW 0B0H
MOVWF TMR1L
BCF PIR1,TMR0IF
BSF T1CON,0
BA BTFSS PIR1,TMR1IF
BRA BA
BCF T1CON,0


RETURN



SSDELAY ;1MS
MOVLW 30H
MOVWF T1CON
MOVLW 0F4H
MOVWF TMR1H
MOVLW 24H
MOVWF TMR1L
BCF PIR1,TMR1IF
BSF T1CON,0
BA3 BTFSS PIR1,TMR1IF
BRA BA3
BCF T1CON,0


RETURN




;*****************INITIAL DISPLAY******************************

INITIALDISPLAY

MOVLW A' '
CALL DATAWRT
CALL SSDELAY
MOVLW A' '
CALL DATAWRT
CALL SSDELAY
MOVLW A' '
CALL DATAWRT
CALL SSDELAY
MOVLW A' '
CALL DATAWRT
CALL SSDELAY
MOVLW A' '
CALL DATAWRT
CALL SSDELAY
MOVLW A'V'
CALL DATAWRT
CALL SSDELAY
MOVLW A'I'
CALL DATAWRT
CALL SSDELAY
MOVLW A'S'
CALL DATAWRT
CALL SSDELAY
MOVLW A'I'
CALL DATAWRT
CALL SSDELAY
MOVLW A'T'
CALL DATAWRT
CALL SSDELAY
MOVLW A'O'
CALL DATAWRT
CALL SSDELAY
MOVLW A'R'
CALL DATAWRT
CALL SSDELAY

MOVLW 0C0H
CALL COMWRT
CALL SSDELAY


MOVLW A' '
CALL DATAWRT
CALL SSDELAY
MOVLW A' '
CALL DATAWRT
CALL SSDELAY
MOVLW A' '
CALL DATAWRT
CALL SSDELAY
MOVLW A' '
CALL DATAWRT
CALL SSDELAY
MOVLW A' '
CALL DATAWRT
CALL SSDELAY
MOVLW A'C'
CALL DATAWRT
CALL SSDELAY
MOVLW A'O'
CALL DATAWRT
CALL SSDELAY
MOVLW A'U'
CALL DATAWRT
CALL SSDELAY
MOVLW A'N'
CALL DATAWRT
CALL SSDELAY
MOVLW A'T'
CALL DATAWRT
CALL SSDELAY
MOVLW A'E'
CALL DATAWRT
CALL SSDELAY
MOVLW A'R'
CALL DATAWRT
CALL SSDELAY


RETURN

;*************************************INITIAL DISP END******************




;***********************HEX TO ASCII8**********************************





H2A

MOVWF 35H ;JO NUMBER CONVERT KARNA HAI;
movlw 0Ah ; 10
movwf 55h

CPFSLT 35H
BRA GREATER
MOVLW 30H
ADDWF 35H

MOVLW 30H
CALL DATAWRT
CALL SSDELAY

MOVF 35H,W
CALL DATAWRT
CALL SSDELAY


RETURN

GREATER

;BITS KO ALAG KARNA HAI:

;DIV 

MOVLW 00H
MOVWF 07H
MOVFF 35H,36H
MOVLW 0AH

DIVLOOP INCF 07H
SUBWF 36H,F
BNN DIVLOOP
DECF 07H
ADDWF 36H,F ;REMAINDER

;36H CONTAINS REMAINDER
;07H CONTAINS QUOTIENT
MOVLW 30H
ADDWF 07H;;07 CONTAINS FIRST BIT OF TIMER
MOVF 07H,W
CALL DATAWRT
CALL SSDELAY

MOVLW 30H
ADDWF 36H;;07 CONTAINS 2ND BIT OF TIMER
MOVF 36H,W
CALL DATAWRT
CALL SSDELAY


RETURN




;**************************HEX TO ASCII**********************



ISR
ORG 700H
INCF 00H

BCF T0CON,TMR0ON
BCF INTCON,TMR0IF
RETFIE








end


